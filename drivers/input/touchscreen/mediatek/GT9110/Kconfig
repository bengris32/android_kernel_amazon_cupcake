## drivers/input/touchscreen/mediatek/GT9110/Kconfig
```kconfig
#
# Touchscreen driver configuration
#
menu "GT9110 Touchscreen Config"
	depends on TOUCHSCREEN_MTK_GT9110

#if TOUCHSCREEN_MTK_GT9XX

config GTP_USE_PINCTRL
	bool "GT9110 GPIO use Pinctrl"
	default n
	help
	Say Y here if you build GT9110 driver on MTK Phone platform.

	Say N here if you build GT9110 driver on MTK Tablet platform.

config GTP_FIRMWARE
	string "GT9110 firmawre group"
	default "firmware"

config GTP_CONFIG
	string "GT9110 config data group"
	default "config0"

config GTP_DRIVER_SEND_CFG
	bool "GT9110 driver send config"
	default y
	help
	Say Y here if you have GT9110 touch panel GTP_DRIVER_SEND_CFG.

	If unsure, say N.

config GTP_CUSTOM_CFG
	bool "GT9110 custom config"
	default n
	help
	Say Y here if you have GT9110 touch panel GTP_CUSTOM_CFG.

	If unsure, say N.

config GTP_HAVE_TOUCH_KEY
	bool "GT9110 touch key enable"
	default n
	help
	Say Y here if you have GT9110 touch panel GTP_HAVE_TOUCH_KEY.

	If unsure, say N.

config GTP_WITH_HOVER
	bool "GT9110 hover enable"
	default n
	help
	Say Y here if you have GT967 touch panel GTP_WITH_HOVER.

	If unsure, say N.

config GTP_CHANGE_X2Y
	bool "GT9110 X2Y"
	default n
	help
	Say Y here if you have GT9110 touch panel GTP_CHANGE_X2Y.

	If unsure, say N.

config GTP_COMPATIBLE_MODE
	bool "GT9110 flahless compatible"
	default n
	help
	Say Y here if you have GT9110 touch panel GTP_COMPATIBLE_MODE.

	If unsure, say N.

config GTP_WARP_X_ON
	bool "GT9110 swap x"
	default n
	help
	Say Y here if you have GT9110 touch panel GTP_WARP_X_ON.

	If unsure, say N.

config GTP_WARP_Y_ON
	bool "GT9110 swap y"
	default n
	help
	Say Y here if you have GT9110 touch panel GTP_WARP_Y_ON.

	If unsure, say N.

config GTP_GESTURE_WAKEUP
	bool "GT9110 gesture wakeup"
	default n
	help
	Say Y here if you have GT9110 touch panel GTP_GESTURE_WAKEUP.

	If unsure, say N.

config GTP_HOTKNOT
	bool "GT9110 hotknot"
	default n
	help
	Say Y here if you have GT9110 touch panel GTP_HOTKNOT.

	If unsure, say N.

config HOTKNOT_BLOCK_RW
	bool "GT9110 hotknot blocking rw"
	default n
	help
	Say Y here if you have GT9110 touch panel HOTKNOT_BLOCK_RW.

	If unsure, say N.

config GTP_PROXIMITY
	bool "GT9110 proximity"
	default n
	help
	Say Y here if you have GT9110 touch panel GTP_PROXIMITY.

	If unsure, say N.

config GTP_AUTO_UPDATE
	bool "GT9110 firmware auto update"
	default n
	help
	Say Y here if you have GT9110 touch panel GTP_AUTO_UPDATE.

	If unsure, say N.

config GTP_AUTO_UPDATE_CFG
	bool "GT9110 config data auto update"
	default n
	help
	Say Y here if you have GT9110 touch panel GTP_AUTO_UPDATE_CFG.

	If unsure, say N.

config GTP_REQUEST_FW_UPDATE
	bool "GT9110 firmware in request firmware"
	default n
	help
	Say Y here if you have GT9110 touch panel GTP_REQUEST_FW_UPDATE.

	If unsure, say N.

config GTP_SUPPORT_I2C_DMA
	bool "GT9110 support i2c dma"
	default n
	help
	Say Y here if you have GT9110 touch panel GTP_SUPPORT_I2C_DMA.

	If unsure, say N.

config GTP_CREATE_WR_NODE
	bool "GT9110 create debug node"
	default y
	help
	Say Y here if you have GT9110 touch panel GTP_CREATE_WR_NODE.

	If unsure, say N.

config GTP_ESD_PROTECT
	bool "GT9110 esd protection"
	default y
	help
	Say Y here if you have GT9110 touch panel GTP_ESD_PROTECT.

	If unsure, say N.

config GTP_CHARGER_DETECT
	bool "GT9110 charger detection"
	default n
	help
	Say Y here if you have GT9110 touch panel GTP_CHARGER_DETECT.

	If unsure, say N.

config GTP_CHARGER_SWITCH
	bool "GT9110 for Mediatek package"
	default n
	help
	Say Y here if you have GT9110 touch panel GTP_CHARGER_SWITCH.

	If unsure, say N.

config GTP_DEBUG_ARRAY_ON
	bool "GT9110 debug array"
	default n
	help
	Say Y here if you have GT9110 touch panel GTP_DEBUG_ARRAY_ON.

	If unsure, say N.

config GTP_DEBUG_FUNC_ON
	bool "GT9110 debug func on"
	default n
	help
	Say Y here if you have GT9110 touch panel GTP_DEBUG_FUNC_ON.

	If unsure, say N.

config GTP_DEBUG_ON
	bool "GT9110 debug on"
	default y
	help
	Say Y here if you have GT9110 touch panel GTP_DEBUG_ON.

	If unsure, say N.

config GTP_POWER_CTRL_SLEEP
	bool "GT9110 power down when sleeping"
	default n
	help
	Say Y here if you have GT9110 touch panel GTP_POWER_CTRL_SLEEP.

	If unsure, say N.

#endif
endmenu
```

## drivers/input/touchscreen/mediatek/GT967/Kconfig
```kconfig
#
# Touchscreen driver configuration
#
menu "GT967 Touchscreen Config"
	depends on TOUCHSCREEN_MTK_GT967

#if TOUCHSCREEN_MTK_GT9XX

config GTP_USE_PINCTRL
	bool "GT967 GPIO use Pinctrl"
	default n
	help
	Say Y here if you build GT967 driver on MTK Phone platform.

	Say N here if you build GT967 driver on MTK Tablet platform.

config GTP_FIRMWARE
	string "GT967 firmawre group"
	default "firmware"

config GTP_CONFIG
	string "GT967 config data group"
	default "config0"

config GTP_DRIVER_SEND_CFG
	bool "GT967 driver send config"
	default y
	help
	Say Y here if you have GT967 touch panel GTP_DRIVER_SEND_CFG.

	If unsure, say N.

config GTP_CUSTOM_CFG
	bool "GT967 custom config"
	default n
	help
	Say Y here if you have GT967 touch panel GTP_CUSTOM_CFG.

	If unsure, say N.

config GTP_HAVE_TOUCH_KEY
	bool "GT967 touch key enable"
	default n
	help
	Say Y here if you have GT967 touch panel GTP_HAVE_TOUCH_KEY.

	If unsure, say N.

config GTP_WITH_HOVER
	bool "GT967 hover enable"
	default n
	help
	Say Y here if you have GT967 touch panel GTP_WITH_HOVER.

	If unsure, say N.

config GTP_CHANGE_X2Y
	bool "GT967 X2Y"
	default n
	help
	Say Y here if you have GT967 touch panel GTP_CHANGE_X2Y.

	If unsure, say N.

config GTP_COMPATIBLE_MODE
	bool "GT967 flahless compatible"
	default n
	help
	Say Y here if you have GT967 touch panel GTP_COMPATIBLE_MODE.

	If unsure, say N.

config GTP_WARP_X_ON
	bool "GT967 swap x"
	default n
	help
	Say Y here if you have GT967 touch panel GTP_WARP_X_ON.

	If unsure, say N.

config GTP_WARP_Y_ON
	bool "GT967 swap y"
	default n
	help
	Say Y here if you have GT967 touch panel GTP_WARP_Y_ON.

	If unsure, say N.

config GTP_GESTURE_WAKEUP
	bool "GT967 gesture wakeup"
	default n
	help
	Say Y here if you have GT967 touch panel GTP_GESTURE_WAKEUP.

	If unsure, say N.

config GTP_HOTKNOT
	bool "GT967 hotknot"
	default n
	help
	Say Y here if you have GT967 touch panel GTP_HOTKNOT.

	If unsure, say N.

config HOTKNOT_BLOCK_RW
	bool "GT967 hotknot blocking rw"
	default n
	help
	Say Y here if you have GT967 touch panel HOTKNOT_BLOCK_RW.

	If unsure, say N.

config GTP_PROXIMITY
	bool "GT967 proximity"
	default n
	help
	Say Y here if you have GT967 touch panel GTP_PROXIMITY.

	If unsure, say N.

config GTP_AUTO_UPDATE
	bool "GT967 firmware auto update"
	default y
	help
	Say Y here if you have GT967 touch panel GTP_AUTO_UPDATE.

	If unsure, say N.

config GTP_AUTO_UPDATE_CFG
	bool "GT967 config data auto update"
	default n
	help
	Say Y here if you have GT967 touch panel GTP_AUTO_UPDATE_CFG.

	If unsure, say N.

config GTP_REQUEST_FW_UPDATE
	bool "GT967 firmware in request firmware"
	default n
	help
	Say Y here if you have GT967 touch panel GTP_REQUEST_FW_UPDATE.

	If unsure, say N.

config GTP_SUPPORT_I2C_DMA
	bool "GT967 support i2c dma"
	default n
	help
	Say Y here if you have GT967 touch panel GTP_SUPPORT_I2C_DMA.

	If unsure, say N.

config GTP_CREATE_WR_NODE
	bool "GT967 create debug node"
	default y
	help
	Say Y here if you have GT967 touch panel GTP_CREATE_WR_NODE.

	If unsure, say N.

config GTP_ESD_PROTECT
	bool "GT967 esd protection"
	default y
	help
	Say Y here if you have GT967 touch panel GTP_ESD_PROTECT.

	If unsure, say N.

config GTP_CHARGER_DETECT
	bool "GT967 charger detection"
	default n
	help
	Say Y here if you have GT967 touch panel GTP_CHARGER_DETECT.

	If unsure, say N.

config GTP_CHARGER_SWITCH
	bool "GT967 for Mediatek package"
	default n
	help
	Say Y here if you have GT967 touch panel GTP_CHARGER_SWITCH.

	If unsure, say N.

config GTP_DEBUG_ARRAY_ON
	bool "GT967 debug array"
	default n
	help
	Say Y here if you have GT967 touch panel GTP_DEBUG_ARRAY_ON.

	If unsure, say N.

config GTP_DEBUG_FUNC_ON
	bool "GT967 debug func on"
	default n
	help
	Say Y here if you have GT967 touch panel GTP_DEBUG_FUNC_ON.

	If unsure, say N.

config GTP_DEBUG_ON
	bool "GT967 debug on"
	default y
	help
	Say Y here if you have GT967 touch panel GTP_DEBUG_ON.

	If unsure, say N.

config GTP_POWER_CTRL_SLEEP
	bool "GT967 power down when sleeping"
	default n
	help
	Say Y here if you have GT967 touch panel GTP_POWER_CTRL_SLEEP.

	If unsure, say N.

#endif
endmenu
```

## drivers/misc/mediatek/coaxial_input/Kconfig
```kconfig
config MTK_COAXIAL_INPUT
	tristate "abc123/abc123 Coaxial Input Detction Driver"
	---help---

	  Coaxial input detction driver support for
	  abc123/abc123 with MTK SOC

	  If you want to use abc123/abc123 coaxial input
	  detection driver,
	  say Y or M here.

	  If unsure, say N.
```

## drivers/misc/mediatek/optical_input/Kconfig
```kconfig
config MTK_OPTICAL_INPUT
	tristate "abc123/abc123 Optical Input Detction Driver"
	---help---

	  Optical input detction driver support for
	  abc123/abc123 with MTK SOC

	  If you want to use abc123/abc123 optical input
	  detection driver,
	  say Y or M here.

	  If unsure, say N.
```

## drivers/misc/mediatek/temperature/Kconfig
```kconfig
config CUSTOM_KERNEL_TEMPERATURE
	bool "CONFIG_CUSTOM_KERNEL_TEMPERATURE"
	help
	  To detect temperature raw data

source "drivers/misc/mediatek/temperature/virtualts/Kconfig"
```

## drivers/misc/mediatek/temperature/virtualts/Kconfig
```kconfig
config MTK_VIRTUAL_TS
	bool "virtual temperature sensor for MediaTek package"
	default n
	help
	It support different type sensor
	in this platform. If this option
	is set, it will support humidity
	by virtual temperature sensor.
```

## drivers/staging/amazon/Kconfig
```kconfig
menu "Amazon"

config AMAZON
       bool "Amazon Drivers"
       ---help---
         Enable support for various drivers needed
         on the Amazon Fire OS platform. CONFIG_AMAZON
         is required to obtain the reboot life cycle
         reasons for MTK platform.

if AMAZON

config AMAZON_LIFE_CYCLE_REASONS
       bool "Amazon Life Cycle Reasons"
       ---help---
         Enable the life cycle metrics to log device
         boot and shutdown information.
         CONFIG AMAZON has to be enabled for
         AMAZON_LIFE_CYCLE_REASONS.

config AMAZON_A2DP_TS
	bool "Gather and report A2DP timestamps"
	help
	Enable A2DP timestamps reporting to user space

choice
	prompt "A2DP timestamps"
	depends on AMAZON_A2DP_TS
	default AMAZON_A2DP_TS_SDIO

config AMAZON_A2DP_TS_SDIO
	bool "A2DP timestamps are gathered when we trigger SDIO transfer"

endchoice

endif # if AMAZON

endmenu
```
